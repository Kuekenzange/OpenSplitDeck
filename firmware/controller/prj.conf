## prj.conf
```kconfig
CONFIG_ESB=y
CONFIG_LOG=n
CONFIG_SERIAL=n
CONFIG_CONSOLE=n
CONFIG_UART_CONSOLE=n
CONFIG_GPIO=y
CONFIG_ADC_ASYNC=y
# Enable ADC for analog inputs
CONFIG_ADC=y

# Enable I2C for trackpad and display
CONFIG_I2C=y
# I2C timeout protection to prevent freezes from unresponsive devices (100ms timeout)
CONFIG_I2C_NRFX_TRANSFER_TIMEOUT=100

# Disable NFC to free up P0.09 and P0.10 for DRV2605 haptic control
CONFIG_NFCT_PINS_AS_GPIOS=y

# Display support for SSD1306
CONFIG_DISPLAY=y
CONFIG_SSD1306=y

# LVGL Graphics Library (temporarily disabled - causing boot issues)
# CONFIG_LVGL=y
# CONFIG_LV_Z_VDB_SIZE=16
# CONFIG_LV_COLOR_DEPTH_1=y
# CONFIG_LV_Z_MEM_POOL_SIZE=8192

# Enable sensor subsystem for IMU
CONFIG_SENSOR=y
CONFIG_LSM6DSL=y

# Enable ESB
CONFIG_ESB_MAX_PAYLOAD_LENGTH=32

# Settings subsystem for NVS storage
CONFIG_SETTINGS=y
CONFIG_SETTINGS_NVS=y
CONFIG_NVS=y
CONFIG_FLASH=y
CONFIG_FLASH_MAP=y
CONFIG_MPU_ALLOW_FLASH_WRITE=y

# Power Management for nRF52840
CONFIG_PM=y
CONFIG_POWEROFF=y
CONFIG_PM_DEVICE=y
CONFIG_TICKLESS_KERNEL=y
CONFIG_GPIO_ENABLE_DISABLE_INTERRUPT=y

# Enable SAADC driver
CONFIG_NRFX_SAADC=y

# Logging levels
CONFIG_LOG_DEFAULT_LEVEL=3
CONFIG_ESB_LOG_LEVEL_INF=y
CONFIG_LOG_PRINTK=y
CONFIG_LOG_BUFFER_SIZE=8192
CONFIG_LOG_PROCESS_THREAD_STACK_SIZE=1024

# System
CONFIG_MAIN_STACK_SIZE=2048
CONFIG_SYSTEM_WORKQUEUE_STACK_SIZE=2048
```

## src/display.c
```c
/**
 * @file display.c
 * @brief Display library implementation for SSD1306 OLED display
 */

#include "display.h"
#include "ui_Images.h"
#include <string.h>

LOG_MODULE_REGISTER(display_lib, LOG_LEVEL_ERR);

// Display device
static const struct device *display_dev = NULL;
static uint8_t controller_id = 0;

/**
 * @brief Initialize the display system
 */
int display_library_init(uint8_t ctrl_id)
{
    controller_id = ctrl_id;
    
    display_dev = DEVICE_DT_GET(DT_CHOSEN(zephyr_display));
    if (!device_is_ready(display_dev)) {
        return -ENODEV;
    }

    display_blanking_off(display_dev);
    return 0;
}

/**
 * @brief Get the current display status
 */
display_status_t display_get_status(void)
{
    if (display_dev && device_is_ready(display_dev)) {
        return DISPLAY_STATUS_READY;
    }
    return DISPLAY_STATUS_ERROR;
}

// Display buffer for drawing
static uint8_t display_buffer[DISPLAY_BUFFER_SIZE];

/**
 * @brief Clear the display buffer
 */
void display_clear(void)
{
    memset(display_buffer, 0, DISPLAY_BUFFER_SIZE);
}

/**
 * @brief Set a pixel in the display buffer
 */
void display_set_pixel(int16_t x, int16_t y, bool on)
{
    if (x >= 0 && x < DISPLAY_WIDTH && y >= 0 && y < DISPLAY_HEIGHT) {
        if (on) {
            display_buffer[x + (y / 8) * DISPLAY_WIDTH] |= (1 << (y & 7));
        } else {
            display_buffer[x + (y / 8) * DISPLAY_WIDTH] &= ~(1 << (y & 7));
        }
    }
}

/**
 * @brief Draw a simple letter at specified position - using original designs
 */
void display_draw_letter(char letter, int16_t x, int16_t y)
{
    static const uint8_t GLYPH_A[7] = {0x0E, 0x11, 0x11, 0x1F, 0x11, 0x11, 0x11};
    static const uint8_t GLYPH_C[7] = {0x0E, 0x11, 0x10, 0x10, 0x10, 0x11, 0x0E};
    static const uint8_t GLYPH_E[7] = {0x1F, 0x10, 0x10, 0x1E, 0x10, 0x10, 0x1F};
    static const uint8_t GLYPH_L[7] = {0x10, 0x10, 0x10, 0x10, 0x10, 0x10, 0x1F};
    static const uint8_t GLYPH_M[7] = {0x11, 0x1B, 0x15, 0x15, 0x11, 0x11, 0x11};
    static const uint8_t GLYPH_N[7] = {0x11, 0x19, 0x15, 0x13, 0x11, 0x11, 0x11};
    static const uint8_t GLYPH_O[7] = {0x0E, 0x11, 0x11, 0x11, 0x11, 0x11, 0x0E};
    static const uint8_t GLYPH_R[7] = {0x1E, 0x11, 0x11, 0x1E, 0x14, 0x12, 0x11};
    static const uint8_t GLYPH_T[7] = {0x1F, 0x04, 0x04, 0x04, 0x04, 0x04, 0x04};
    static const uint8_t GLYPH_V[7] = {0x11, 0x11, 0x11, 0x11, 0x0A, 0x0A, 0x04};
    static const uint8_t GLYPH_X[7] = {0x11, 0x11, 0x0A, 0x04, 0x0A, 0x11, 0x11};
    static const uint8_t GLYPH_Y[7] = {0x11, 0x11, 0x0A, 0x04, 0x04, 0x04, 0x04};

    const uint8_t *glyph = NULL;
    char upper = letter;
    if (upper >= 'a' && upper <= 'z') {
        upper = (char)(upper - ('a' - 'A'));
    }

    switch (upper) {
        case 'A': glyph = GLYPH_A; break;
        case 'C': glyph = GLYPH_C; break;
        case 'E': glyph = GLYPH_E; break;
        case 'L': glyph = GLYPH_L; break;
        case 'M': glyph = GLYPH_M; break;
        case 'N': glyph = GLYPH_N; break;
        case 'O': glyph = GLYPH_O; break;
        case 'R': glyph = GLYPH_R; break;
        case 'T': glyph = GLYPH_T; break;
        case 'V': glyph = GLYPH_V; break;
        case 'X': glyph = GLYPH_X; break;
        case 'Y': glyph = GLYPH_Y; break;
        default:
            return;
    }

    for (int row = 0; row < 7; row++) {
        for (int col = 0; col < 5; col++) {
            if (glyph[row] & (1 << (4 - col))) {
                display_set_pixel(x + col, y + row, true);
            }
        }
    }
}

static void display_draw_word(int16_t x, int16_t y, const char *text)
{
    if (!text) {
        return;
    }

    int16_t cx = x;
    for (size_t i = 0; text[i] != '\0'; i++) {
        display_draw_letter(text[i], cx, y);
        cx += 6; // 5px glyph + 1px spacing
    }
}

/**
 * @brief Draw controller identification (without writing to display)
 */
void display_draw_controller_id(uint8_t ctrl_id)
{
    // Just draw to buffer, don't write to display yet
    // Position for 5x7 glyph in center
    int16_t letter_x = (DISPLAY_WIDTH - 5) / 2;
    int16_t letter_y = (DISPLAY_HEIGHT - 7) / 2;
    
    if (ctrl_id == 0) {
        display_draw_letter('R', letter_x, letter_y);
    } else {
        display_draw_letter('L', letter_x, letter_y);
    }
}

/**
 * @brief Write display buffer to screen (call only when content changes)
 */
void display_refresh_screen(void)
{
    if (!display_dev || !device_is_ready(display_dev)) {
        return;
    }
    
    struct display_buffer_descriptor desc = {
        .buf_size = DISPLAY_BUFFER_SIZE,
        .width = DISPLAY_WIDTH,
        .height = DISPLAY_HEIGHT,
        .pitch = DISPLAY_WIDTH
    };
    
    display_write(display_dev, 0, 0, &desc, display_buffer);
}

/**
 * @brief Main display update function
 */
void display_update(void)
{
    // This function is called by the display thread but shouldn't 
    // automatically redraw - let the screen state system handle it
    // Only refresh if we're in default mode
    static bool last_was_default = true;
    static bool initialized = false;
    
    if (!initialized) {
        display_show_status_screen();
        initialized = true;
        last_was_default = true;
    }
}

/**
 * @brief Enable/disable display blanking
 */
int display_set_blanking(bool blank)
{
    if (!display_dev) {
        return -ENODEV;
    }
    
    if (blank) {
        return display_blanking_on(display_dev);
    } else {
        return display_blanking_off(display_dev);
    }
}

void display_draw_hline(int16_t x, int16_t y, int16_t width)
{
    for (int16_t i = 0; i < width; i++) {
        display_set_pixel(x + i, y, true);
    }
}

/**
 * @brief Draw a vertical line
 */
void display_draw_vline(int16_t x, int16_t y, int16_t height)
{
    for (int16_t i = 0; i < height; i++) {
        display_set_pixel(x, y + i, true);
    }
}

/**
 * @brief Draw a rectangle
 */
void display_draw_rect(int16_t x, int16_t y, int16_t width, int16_t height, bool filled)
{
    if (filled) {
        for (int16_t i = 0; i < height; i++) {
            display_draw_hline(x, y + i, width);
        }
    } else {
        display_draw_hline(x, y, width);                    // Top
        display_draw_hline(x, y + height - 1, width);       // Bottom
        display_draw_vline(x, y, height);                   // Left
        display_draw_vline(x + width - 1, y, height);       // Right
    }
}

/**
 * @brief Draw a bitmap image from a byte array
 * 
 * @param x X position for top-left corner
 * @param y Y position for top-left corner
 * @param width Width of the bitmap in pixels
 * @param height Height of the bitmap in pixels
 * @param bitmap Pointer to bitmap data (1 bit per pixel, MSB first)
 */
void display_draw_bitmap(int16_t x, int16_t y, int16_t width, int16_t height, const uint8_t* bitmap)
{
    if (!bitmap) return;
    
    for (int16_t row = 0; row < height; row++) {
        for (int16_t col = 0; col < width; col++) {
            // Calculate byte and bit position
            int16_t bit_index = row * width + col;
            int16_t byte_index = bit_index / 8;
            int16_t bit_position = 7 - (bit_index % 8); // MSB first
            
            // Check if pixel should be on
            bool pixel_on = (bitmap[byte_index] & (1 << bit_position)) != 0;
            
            // Draw the pixel
            display_set_pixel(x + col, y + row, pixel_on);
        }
    }
}

/**
 * @brief Draw a bitmap with transparency (0 = transparent, 1 = on, 2 = off)
 * 
 * @param x X position for top-left corner
 * @param y Y position for top-left corner  
 * @param width Width of the bitmap in pixels
 * @param height Height of the bitmap in pixels
 * @param bitmap Pointer to bitmap data (2 bits per pixel: 00=transparent, 01=off, 10=on, 11=on)
 */
void display_draw_bitmap_transparent(int16_t x, int16_t y, int16_t width, int16_t height, const uint8_t* bitmap)
{
    if (!bitmap) return;
    
    for (int16_t row = 0; row < height; row++) {
        for (int16_t col = 0; col < width; col++) {
            // Calculate bit position (2 bits per pixel)
            int16_t pixel_index = row * width + col;
            int16_t byte_index = pixel_index / 4; // 4 pixels per byte
            int16_t bit_shift = 6 - ((pixel_index % 4) * 2); // 2 bits per pixel, MSB first
            
            // Extract 2-bit pixel value
            uint8_t pixel_value = (bitmap[byte_index] >> bit_shift) & 0x03;
            
            // Draw based on pixel value
            switch (pixel_value) {
                case 0x00: // Transparent - don't draw
                    break;
                case 0x01: // Off (black)
                    display_set_pixel(x + col, y + row, false);
                    break;
                case 0x02: // On (white)  
                case 0x03: // On (white)
                    display_set_pixel(x + col, y + row, true);
                    break;
            }
        }
    }
}
void display_draw_number(int16_t x, int16_t y, uint8_t number)
{
    // Simple 3x5 pixel font for numbers 0-9 - original design
    // Coordinates will be rotated by display_set_pixel
    
    const uint8_t font_3x5[][5] = {
        {0x7, 0x5, 0x5, 0x5, 0x7}, // 0
        {0x2, 0x2, 0x2, 0x2, 0x2}, // 1
        {0x7, 0x1, 0x7, 0x4, 0x7}, // 2
        {0x7, 0x1, 0x7, 0x1, 0x7}, // 3
        {0x5, 0x5, 0x7, 0x1, 0x1}, // 4
        {0x7, 0x4, 0x7, 0x1, 0x7}, // 5
        {0x7, 0x4, 0x7, 0x5, 0x7}, // 6
        {0x7, 0x1, 0x1, 0x1, 0x1}, // 7
        {0x7, 0x5, 0x7, 0x5, 0x7}, // 8
        {0x7, 0x5, 0x7, 0x1, 0x7}  // 9
    };
    
    if (number > 9) return;
    
    for (int row = 0; row < 5; row++) {
        for (int col = 0; col < 3; col++) {
            if (font_3x5[number][row] & (1 << (2 - col))) {
                display_set_pixel(x + col, y + row, true);
            }
        }
    }
}

/**
 * @brief Display analog values screen (simple vertical layout)
 */
void display_show_analog_screen(int16_t stick_x, int16_t stick_y, uint8_t trigger)
{
    display_clear();
    
    // Simple vertical layout for vertical screen
    // X value
    display_draw_letter('X', 2, 2);
    display_set_pixel(10, 4, true); // Colon
    
    uint16_t x_display = stick_x + 127;
    display_draw_number(12, 2, (x_display / 100) % 10);
    display_draw_number(16, 2, (x_display / 10) % 10);
    display_draw_number(20, 2, x_display % 10);
    
    // Y value
    display_draw_letter('Y', 2, 10);
    display_set_pixel(10, 12, true); // Colon
    
    uint16_t y_display = stick_y + 127;
    display_draw_number(12, 10, (y_display / 100) % 10);
    display_draw_number(16, 10, (y_display / 10) % 10);
    display_draw_number(20, 10, y_display % 10);
    
    // Trigger value
    display_draw_letter('T', 2, 18);
    display_set_pixel(10, 20, true); // Colon
    
    display_draw_number(12, 18, (trigger / 100) % 10);
    display_draw_number(16, 18, (trigger / 10) % 10);
    display_draw_number(20, 18, trigger % 10);
    
    display_refresh_screen();
}

/**
 * @brief Draw battery level indicator with voltage inside battery symbol
 */
void display_draw_battery_level(int16_t x, int16_t y, uint16_t voltage_mv)
{
    // First draw the battery outline
    display_draw_bitmap(x, y, 32, 32, bitmap_battery_sym);
    
    // Calculate battery percentage (assuming 3.2V-4.2V range)
    uint8_t percentage = 0;
    if (voltage_mv >= 4200) {
        percentage = 100;
    } else if (voltage_mv <= 3200) {
        percentage = 0;
    } else {
        // Linear mapping: 3200mV=0%, 4200mV=100%
        percentage = ((voltage_mv - 3200) * 100) / (4200 - 3200);
    }
    
    // Convert to 5 distinct levels with hysteresis to prevent flashing
    static uint8_t last_level = 0;
    uint8_t level = percentage / 20;  // 0-19%=0, 20-39%=1, 40-59%=2, 60-79%=3, 80-100%=4
    if (level > 4) level = 4;
    
    // Add hysteresis: only change level if we're clearly in the new range
    if (level > last_level) {
        // Going up: need to be at least 2% into the new level
        if (percentage < (level * 20 + 2)) {
            level = last_level;
        }
    } else if (level < last_level) {
        // Going down: need to be at least 2% below the old level  
        if (percentage > ((last_level * 20) - 2)) {
            level = last_level;
        }
    }
    last_level = level;
    
    // Battery bitmap is horizontal: terminal at top, body in middle, closed at bottom
    // Screen is vertical so adjust Y coordinate (move "up" on vertical screen)
    // Interior spans roughly x+10 to x+21 (width) and y+2 to y+25 (height)
    
    if (level > 0) {
        // Level 1 (20%): Top horizontal segment  
        for (int16_t fill_y = y + 2; fill_y <= y + 6; fill_y++) {
            for (int16_t fill_x = x + 10; fill_x <= x + 21; fill_x++) {
                display_set_pixel(fill_x, fill_y, true);
            }
        }
    }
    
    if (level > 1) {
        // Level 2 (40%): Second horizontal segment from top
        for (int16_t fill_y = y + 7; fill_y <= y + 11; fill_y++) {
            for (int16_t fill_x = x + 10; fill_x <= x + 21; fill_x++) {
                display_set_pixel(fill_x, fill_y, true);
            }
        }
    }
    
    if (level > 2) {
        // Level 3 (60%): Middle horizontal segment
        for (int16_t fill_y = y + 12; fill_y <= y + 16; fill_y++) {
            for (int16_t fill_x = x + 10; fill_x <= x + 21; fill_x++) {
                display_set_pixel(fill_x, fill_y, true);
            }
        }
    }
    
    if (level > 3) {
        // Level 4 (80%): Fourth horizontal segment from top
        for (int16_t fill_y = y + 17; fill_y <= y + 21; fill_y++) {
            for (int16_t fill_x = x + 10; fill_x <= x + 21; fill_x++) {
                display_set_pixel(fill_x, fill_y, true);
            }
        }
    }
    
    if (level >= 4) {
        // Level 5 (100%): Bottom horizontal segment
        for (int16_t fill_y = y + 22; fill_y <= y + 26; fill_y++) {
            for (int16_t fill_x = x + 10; fill_x <= x + 21; fill_x++) {
                display_set_pixel(fill_x, fill_y, true);
            }
        }
    }
}

/**
 * @brief Display controller status screen
 */
/**
 * @brief Display controller status screen with battery level
 */
void display_show_status_screen_with_battery(uint16_t battery_mv)
{
    display_clear();
    
    // Draw the appropriate controller bitmap (96x32 pixels)
    if (controller_id == 0) {
        // Right controller (ID 0)
        display_draw_bitmap(0, 0, 96, 32, bitmap_RightController_Tall);
    } else {
        // Left controller (ID 1) 
        display_draw_bitmap(0, 0, 96, 32, bitmap_LeftController_Tall);
    }

    // Draw battery level indicator at position (96, 0)
    display_draw_battery_level(96, 0, battery_mv);
    
    // Write to display only once
    display_refresh_screen();
}

void display_show_status_screen(void)
{
    display_clear();
    
    // Draw the appropriate controller bitmap (32x32 pixels)
    // Center it on the display (128x32, so center is at x=48, y=0)
    if (controller_id == 0) {
        // Right controller (ID 0)
        display_draw_bitmap(0, 0, 96, 32, bitmap_RightController_Tall);
    } else {
        // Left controller (ID 1) 
        display_draw_bitmap(0, 0, 96, 32, bitmap_LeftController_Tall);
    }

    display_draw_bitmap(96, 0, 32, 32, bitmap_battery_sym);
    
    // Write to display only once
    display_refresh_screen();
}

/**
 * @brief Display calibration screen with progress
 */
void display_show_calibration_screen(uint8_t phase, uint8_t progress)
{
    display_clear();

    const char *title = "CAL";
    int title_width = (int)strlen(title) * 6 - 1;
    int16_t title_x = (DISPLAY_WIDTH - title_width) / 2;
    display_draw_word(title_x, 2, title);

    const char *phase_text = (phase == 0) ? "CENTER" : "MOVE";
    int phase_width = (int)strlen(phase_text) * 6 - 1;
    int16_t phase_x = (DISPLAY_WIDTH - phase_width) / 2;
    display_draw_word(phase_x, 12, phase_text);

    // Side marker to confirm LEFT/RIGHT selection on this screen
    display_draw_letter((controller_id == 0) ? 'R' : 'L', 120, 2);
    
    // Draw progress bar
    int16_t bar_width = (progress * 100) / 100;  // Scale to 100 pixels wide
    display_draw_rect(14, 24, 100, 6, false);  // Border
    if (bar_width > 0) {
        display_draw_rect(15, 25, bar_width, 4, true);  // Fill
    }
    
    display_refresh_screen();
}
```

## src/esb_comm_driver.c
```c
/*
 * ESB Communication Driver - Enhanced ShockBurst Communication Implementation
 *
 * This driver provides ESB (Enhanced ShockBurst) wireless communication
 * functionality for the controller system. It handles initialization,
 * data transmission with adaptive timing, and power management.
 */

#include <zephyr/kernel.h>
#include <zephyr/device.h>
#include <zephyr/drivers/clock_control.h>
#include <zephyr/drivers/clock_control/nrf_clock_control.h>
#include <zephyr/logging/log.h>
#include <string.h>
#include <esb.h>
#include "esb_comm_driver.h"

#define PLAYER_ID 2     // Change to 1 for PLAYER 1, 2 for PLAYER 2 (different address set)

LOG_MODULE_REGISTER(esb_comm, LOG_LEVEL_ERR);

// ESB communication context
typedef struct
{
    bool initialized;
    bool enabled;
    esb_comm_config_t config;
    esb_comm_stats_t stats;
    struct esb_payload tx_payload;
    uint32_t last_tx_attempt;
    bool last_tx_succeeded;
    // ACK payload timing support
    bool ack_timing_enabled; // Enable/disable ACK payload timing
    bool ack_timing_active;
    ack_timing_data_t last_ack_data; // Last received ACK payload data
    uint32_t next_tx_delay_ms;
    uint8_t current_rumble_left;  // 0-15 left motor intensity
    uint8_t current_rumble_right; // 0-15 right motor intensity
} esb_comm_context_t;

// Global context
static esb_comm_context_t g_esb_ctx = {0};

// Forward declarations
static int esb_comm_clocks_start(void);
static void esb_comm_event_handler(struct esb_evt const *event);

/**
 * @brief Start high frequency clocks required for ESB
 */
static int esb_comm_clocks_start(void)
{
    int err;
    int res;
    struct onoff_manager *clk_mgr;
    struct onoff_client clk_cli;

    clk_mgr = z_nrf_clock_control_get_onoff(CLOCK_CONTROL_NRF_SUBSYS_HF);
    if (!clk_mgr)
    {
        LOG_ERR("Unable to get the Clock manager");
        return -ENXIO;
    }

    sys_notify_init_spinwait(&clk_cli.notify);

    err = onoff_request(clk_mgr, &clk_cli);
    if (err < 0)
    {
        LOG_ERR("Clock request failed: %d", err);
        return err;
    }

    do
    {
        err = sys_notify_fetch_result(&clk_cli.notify, &res);
        if (!err && res)
        {
            LOG_ERR("Clock could not be started: %d", res);
            return res;
        }
    } while (err);

    LOG_INF("HF clock started for ESB");
    return 0;
}

/**
 * @brief ESB event handler - processes transmission events
 */
static void esb_comm_event_handler(struct esb_evt const *event)
{
    switch (event->evt_id)
    {
    case ESB_EVENT_TX_SUCCESS:
        // Update statistics
        g_esb_ctx.stats.successful_transmissions++;
        g_esb_ctx.last_tx_succeeded = true;

        // Process ACK payload if present
        struct esb_payload ack_payload;
        int err = esb_read_rx_payload(&ack_payload);

        if (err == 0 && ack_payload.length >= sizeof(ack_timing_data_t))
        {
            // Valid ACK payload received - extract timing and rumble data
            memcpy(&g_esb_ctx.last_ack_data, ack_payload.data, sizeof(ack_timing_data_t));

            // Set next transmission delay from ACK payload (only if valid)
            if (g_esb_ctx.last_ack_data.next_delay_ms > 0 && g_esb_ctx.last_ack_data.next_delay_ms < 1000) {
                g_esb_ctx.next_tx_delay_ms = g_esb_ctx.last_ack_data.next_delay_ms;
                g_esb_ctx.ack_timing_active = true;
            } else {
                // Invalid timing data in ACK payload
                g_esb_ctx.ack_timing_active = false;
                g_esb_ctx.next_tx_delay_ms = g_esb_ctx.config.base_tx_interval_ms;
            }

            // Extract rumble data (upper 4 bits = left motor, lower 4 bits = right motor)
            g_esb_ctx.current_rumble_left = (g_esb_ctx.last_ack_data.rumble_data >> 4) & 0x0F;
            g_esb_ctx.current_rumble_right = g_esb_ctx.last_ack_data.rumble_data & 0x0F;

            // Log ACK payload data occasionally
            static uint32_t last_ack_log = 0;
            uint32_t now = k_uptime_get_32();
            if ((now - last_ack_log) > 5000) {
                LOG_INF("ACK payload: delay=%dms, seq=%d, rumble=L%d/R%d, dongle_time=%u",
                        g_esb_ctx.last_ack_data.next_delay_ms,
                        g_esb_ctx.last_ack_data.sequence_num,
                        g_esb_ctx.current_rumble_left,
                        g_esb_ctx.current_rumble_right,
                        g_esb_ctx.last_ack_data.dongle_timestamp);
                last_ack_log = now;
            }
        }
        else
        {
            // No valid ACK payload - fall back to fixed timing
            g_esb_ctx.ack_timing_active = false;
            g_esb_ctx.next_tx_delay_ms = g_esb_ctx.config.base_tx_interval_ms;
            g_esb_ctx.current_rumble_left = 0;
            g_esb_ctx.current_rumble_right = 0;
        }

        // Turn off status LED (if configured)
        if (g_esb_ctx.config.status_led)
        {
            gpio_pin_set_dt(g_esb_ctx.config.status_led, 0);
        }

        // Clear buffers after successful transmission to prevent buildup
        esb_flush_tx();
        break;

    case ESB_EVENT_TX_FAILED:
        // Update statistics
        g_esb_ctx.stats.failed_transmissions++;
        g_esb_ctx.stats.retry_count++;
        g_esb_ctx.last_tx_succeeded = false;

        // On TX failure, disable ACK timing and use retry interval
        g_esb_ctx.ack_timing_active = false;
        g_esb_ctx.next_tx_delay_ms = g_esb_ctx.config.retry_interval_ms;
        g_esb_ctx.current_rumble_left = 0;
        g_esb_ctx.current_rumble_right = 0;

        // Turn off status LED on failure too
        if (g_esb_ctx.config.status_led)
        {
            gpio_pin_set_dt(g_esb_ctx.config.status_led, 0);
        }

        // Clear buffers after failed transmission to prevent radio jam
        esb_flush_tx();
        esb_flush_rx();
        break;

    case ESB_EVENT_RX_RECEIVED:
        // Controller is in PTX mode, shouldn't normally receive data
        // Clear RX buffer to prevent overflow
        esb_flush_rx();
        break;

    default:
        LOG_WRN("Unknown ESB event: %d", event->evt_id);
        // Clear all buffers on unknown events as safety measure
        esb_flush_tx();
        esb_flush_rx();
        break;
    }

    // Update total transmissions and success rate
    g_esb_ctx.stats.total_transmissions = g_esb_ctx.stats.successful_transmissions +
                                          g_esb_ctx.stats.failed_transmissions;

    if (g_esb_ctx.stats.total_transmissions > 0)
    {
        g_esb_ctx.stats.success_rate = (float)g_esb_ctx.stats.successful_transmissions /
                                       g_esb_ctx.stats.total_transmissions * 100.0f;
    }
}

/**
 * @brief Initialize ESB communication driver
 */
esb_comm_status_t esb_comm_driver_init(const esb_comm_config_t *config)
{
    int err;

    if (!config)
    {
        LOG_ERR("Invalid configuration pointer");
        return ESB_COMM_STATUS_ERROR;
    }

    if (g_esb_ctx.initialized)
    {
        LOG_WRN("ESB communication already initialized");
        return ESB_COMM_STATUS_OK;
    }

    LOG_INF("ESB communication driver initialization starting...");

    // Copy configuration
    memcpy(&g_esb_ctx.config, config, sizeof(esb_comm_config_t));

    // Set default values if not specified
    if (g_esb_ctx.config.base_tx_interval_ms == 0)
    {
        g_esb_ctx.config.base_tx_interval_ms = 5; // 5ms default (200Hz) - back to working original
    }
    if (g_esb_ctx.config.retry_interval_ms == 0)
    {
        g_esb_ctx.config.retry_interval_ms = 10; // 10ms retry interval - back to working original
    }
    if (g_esb_ctx.config.rf_channel == 0)
    {
        g_esb_ctx.config.rf_channel = 1; // Default RF channel
    }

    LOG_INF("Controller %d timing offset: +%dms (base: %dms, retry: %dms)",
            g_esb_ctx.config.controller_id, 0,
            g_esb_ctx.config.base_tx_interval_ms, g_esb_ctx.config.retry_interval_ms);

    // Initialize statistics
    memset(&g_esb_ctx.stats, 0, sizeof(esb_comm_stats_t));

    // Start clocks first (required for Nordic nRF52)
    err = esb_comm_clocks_start();
    if (err)
    {
        LOG_ERR("Clock start failed: %d", err);
        return ESB_COMM_STATUS_CLOCK_FAILED;
    }

    // ESB configuration - PTX mode for continuous transmission with ACK timing
    struct esb_config esb_cfg = ESB_DEFAULT_CONFIG;
    esb_cfg.protocol = ESB_PROTOCOL_ESB_DPL; // Dynamic payload length
    esb_cfg.mode = ESB_MODE_PTX;             // Controller transmits data continuously
    esb_cfg.retransmit_delay = 600;          // 600us delay between retransmissions
    esb_cfg.retransmit_count = 2;
    esb_cfg.tx_output_power = 8;             // Maximum TX power (8 dBm)
    esb_cfg.event_handler = esb_comm_event_handler;
    esb_cfg.bitrate = ESB_BITRATE_2MBPS;
    esb_cfg.selective_auto_ack = true; // Enable ACK for timing coordination
    esb_cfg.use_fast_ramp_up = false;  // Disable fast ramp up for stability during ADC activity
    esb_cfg.payload_length = 21;

    // Set up addresses - Player 1 and Player 2 use different address sets
    // Each player has unique RIGHT (pipe 0) and LEFT (pipe 1) addresses
    uint8_t base_addr_0[4]; // RIGHT controller base (pipe 0)
    uint8_t base_addr_1[4]; // LEFT controller base (pipe 1)
    uint8_t addr_prefix[8];
    
    #if PLAYER_ID == 1
        // Player 1 addresses
        base_addr_0[0] = 0xE7; base_addr_0[1] = 0xE7; base_addr_0[2] = 0xE7; base_addr_0[3] = 0xE7;
        base_addr_1[0] = 0xD4; base_addr_1[1] = 0xD4; base_addr_1[2] = 0xD4; base_addr_1[3] = 0xD4;
        addr_prefix[0] = 0xE7; addr_prefix[1] = 0xD4; addr_prefix[2] = 0xC3; addr_prefix[3] = 0xC4;
        addr_prefix[4] = 0xC5; addr_prefix[5] = 0xC6; addr_prefix[6] = 0xC7; addr_prefix[7] = 0xC8;
    #elif PLAYER_ID == 2
        // Player 2 addresses
        base_addr_0[0] = 0xA1; base_addr_0[1] = 0xA1; base_addr_0[2] = 0xA1; base_addr_0[3] = 0xA1;
        base_addr_1[0] = 0xB2; base_addr_1[1] = 0xB2; base_addr_1[2] = 0xB2; base_addr_1[3] = 0xB2;
        addr_prefix[0] = 0xA1; addr_prefix[1] = 0xB2; addr_prefix[2] = 0xA3; addr_prefix[3] = 0xA4;
        addr_prefix[4] = 0xA5; addr_prefix[5] = 0xA6; addr_prefix[6] = 0xA7; addr_prefix[7] = 0xA8;
    #else
        #error "PLAYER_ID must be 1 or 2"
    #endif

    err = esb_init(&esb_cfg);
    if (err)
    {
        LOG_ERR("ESB init failed: %d", err);
        return ESB_COMM_STATUS_CONFIG_FAILED;
    }

    err = esb_set_base_address_0(base_addr_0);
    if (err)
    {
        LOG_ERR("ESB set base address 0 failed: %d", err);
        return ESB_COMM_STATUS_CONFIG_FAILED;
    }

    err = esb_set_base_address_1(base_addr_1);
    if (err)
    {
        LOG_ERR("ESB set base address 1 failed: %d", err);
        return ESB_COMM_STATUS_CONFIG_FAILED;
    }

    err = esb_set_prefixes(addr_prefix, 8);
    if (err)
    {
        LOG_ERR("ESB set prefixes failed: %d", err);
        return ESB_COMM_STATUS_CONFIG_FAILED;
    }

    // Set RF channel
    err = esb_set_rf_channel(g_esb_ctx.config.rf_channel);
    if (err)
    {
        LOG_ERR("ESB set RF channel failed: %d", err);
        return ESB_COMM_STATUS_CONFIG_FAILED;
    }

    LOG_INF("Controller %d using ACK-based timing for interference avoidance",
            g_esb_ctx.config.controller_id);

    // Set radio TX power to 8 (8 dBm for nRF52840)
    err = esb_set_tx_power(ESB_TX_POWER_8DBM);
    if (err)
    {
        LOG_ERR("ESB set TX power failed: %d", err);
        return ESB_COMM_STATUS_CONFIG_FAILED;
    }

    // Configure status LED if provided
    if (g_esb_ctx.config.status_led && gpio_is_ready_dt(g_esb_ctx.config.status_led))
    {
        gpio_pin_configure_dt(g_esb_ctx.config.status_led, GPIO_OUTPUT_INACTIVE);
        LOG_INF("Status LED configured for ESB transmission feedback");
    }

    // Initialize state
    g_esb_ctx.initialized = true;
    g_esb_ctx.enabled = true;
    g_esb_ctx.last_tx_attempt = 0;
    g_esb_ctx.last_tx_succeeded = true;

    LOG_INF("ESB communication driver initialized successfully - ready for transmission");
    LOG_INF("Configuration: ID=%d, Base interval=%dms, Retry interval=%dms, RF channel=%d",
            g_esb_ctx.config.controller_id,
            g_esb_ctx.config.base_tx_interval_ms,
            g_esb_ctx.config.retry_interval_ms,
            g_esb_ctx.config.rf_channel);

    return ESB_COMM_STATUS_OK;
}

/**
 * @brief Check if ESB communication driver is initialized
 */
bool esb_comm_driver_is_initialized(void)
{
    return g_esb_ctx.initialized;
}

/**
 * @brief Send controller data via ESB with adaptive timing (timed version)
 */
esb_comm_status_t esb_comm_send_data_timed(const esb_controller_data_t *data)
{
    if (!g_esb_ctx.initialized || !g_esb_ctx.enabled)
    {
        return ESB_COMM_STATUS_NOT_INITIALIZED;
    }

    if (!data)
    {
        return ESB_COMM_STATUS_ERROR;
    }

    uint32_t now = k_uptime_get_32();
    uint32_t tx_interval;

    // Use ACK payload timing if enabled and available, otherwise fall back to adaptive timing
    if (g_esb_ctx.ack_timing_enabled && g_esb_ctx.ack_timing_active && g_esb_ctx.next_tx_delay_ms > 0)
    {
        // Use timing from dongle's ACK payload
        tx_interval = g_esb_ctx.next_tx_delay_ms;
        
        // Debug logging for ACK timing usage (throttled)
        static uint32_t last_ack_timing_log = 0;
        uint32_t debug_now = k_uptime_get_32();
        if ((debug_now - last_ack_timing_log) > 3000) { // Log every 3 seconds
            LOG_INF("Using ACK timing: %dms (seq=%d)", tx_interval, g_esb_ctx.last_ack_data.sequence_num);
            last_ack_timing_log = debug_now;
        }
    }
    else
    {
        // Fall back to adaptive timing based on controller ID and last TX result
        if (!g_esb_ctx.last_tx_succeeded)
        {
            // If last TX failed (no ACK), use longer interval with controller-specific offset
            tx_interval = g_esb_ctx.config.retry_interval_ms;
        }
        else
        {
            // If last TX succeeded, use base interval with small offset
            tx_interval = g_esb_ctx.config.base_tx_interval_ms;
        }
        
        // Debug logging for fallback timing (throttled)
        static uint32_t last_fallback_log = 0;
        uint32_t debug_now = k_uptime_get_32();
        if ((debug_now - last_fallback_log) > 3000) { // Log every 3 seconds
            const char *reason = !g_esb_ctx.ack_timing_enabled ? "disabled" : 
                               !g_esb_ctx.ack_timing_active ? "inactive" :
                               g_esb_ctx.next_tx_delay_ms == 0 ? "zero_delay" : "unknown";
            LOG_INF("Using fallback timing: %dms (reason: %s)", tx_interval, reason);
            last_fallback_log = debug_now;
        }
    }

    // Check if enough time has passed since last attempt
    if ((now - g_esb_ctx.last_tx_attempt) < tx_interval)
    {
        return ESB_COMM_STATUS_OK; // Too soon to transmit, but not an error
    }

    // Proceed with transmission
    return esb_comm_send_immediate(data);
}

/**
 * @brief Send controller data via ESB immediately (force transmission)
 */
esb_comm_status_t esb_comm_send_immediate(const esb_controller_data_t *data)
{
    if (!g_esb_ctx.initialized || !g_esb_ctx.enabled)
    {
        return ESB_COMM_STATUS_NOT_INITIALIZED;
    }

    if (!data)
    {
        return ESB_COMM_STATUS_ERROR;
    }

    // Check if radio is ready for transmission (critical for preventing overload)
    if (esb_is_idle() != true)
    {
        // Radio is busy - don't queue another packet to prevent buffer overload
        g_esb_ctx.stats.failed_transmissions++;
        return ESB_COMM_STATUS_BUSY;
    }

    // Prepare payload
    g_esb_ctx.tx_payload.length = sizeof(esb_controller_data_t);
    g_esb_ctx.tx_payload.pipe = g_esb_ctx.config.controller_id; // LEFT=1, RIGHT=0
    memcpy(g_esb_ctx.tx_payload.data, data, sizeof(esb_controller_data_t));

    // Clear TX buffer first to prevent buffer overload
    esb_flush_tx();

    // Write payload to radio
    int err = esb_write_payload(&g_esb_ctx.tx_payload);

    // Update timestamp regardless of result
    g_esb_ctx.last_tx_attempt = k_uptime_get_32();
    g_esb_ctx.stats.last_tx_timestamp = g_esb_ctx.last_tx_attempt;

    if (err)
    {
        LOG_WRN("ESB write payload failed: %d (radio overload?)", err);
        g_esb_ctx.stats.failed_transmissions++;
        g_esb_ctx.last_tx_succeeded = false;

        // Additional buffer clearing on error to prevent jam
        esb_flush_tx();
        esb_flush_rx();

        return ESB_COMM_STATUS_TX_FAILED;
    }

    // Turn on status LED (if configured) - will be turned off by event handler on ACK
    if (g_esb_ctx.config.status_led)
    {
        gpio_pin_set_dt(g_esb_ctx.config.status_led, 1);
    }

    // No blocking delay - let event handler process TX events asynchronously

    return ESB_COMM_STATUS_OK;
}

/**
 * @brief Send controller data via ESB (standard interface)
 */
esb_comm_status_t esb_comm_send_data(const esb_controller_data_t *data)
{
    return esb_comm_send_data_timed(data);
}

/**
 * @brief Get current transmission statistics
 */
esb_comm_status_t esb_comm_get_stats(esb_comm_stats_t *stats)
{
    if (!stats)
    {
        return ESB_COMM_STATUS_ERROR;
    }

    if (!g_esb_ctx.initialized)
    {
        return ESB_COMM_STATUS_NOT_INITIALIZED;
    }

    // Update current state
    g_esb_ctx.stats.last_tx_succeeded = g_esb_ctx.last_tx_succeeded;

    memcpy(stats, &g_esb_ctx.stats, sizeof(esb_comm_stats_t));
    return ESB_COMM_STATUS_OK;
}

/**
 * @brief Reset transmission statistics
 */
esb_comm_status_t esb_comm_reset_stats(void)
{
    if (!g_esb_ctx.initialized)
    {
        return ESB_COMM_STATUS_NOT_INITIALIZED;
    }

    memset(&g_esb_ctx.stats, 0, sizeof(esb_comm_stats_t));
    LOG_INF("ESB communication statistics reset");
    return ESB_COMM_STATUS_OK;
}

/**
 * @brief Set transmission timing parameters
 */
esb_comm_status_t esb_comm_set_timing(uint32_t base_interval_ms, uint32_t retry_interval_ms)
{
    if (!g_esb_ctx.initialized)
    {
        return ESB_COMM_STATUS_NOT_INITIALIZED;
    }

    if (base_interval_ms == 0 || retry_interval_ms == 0)
    {
        return ESB_COMM_STATUS_ERROR;
    }

    g_esb_ctx.config.base_tx_interval_ms = base_interval_ms;
    g_esb_ctx.config.retry_interval_ms = retry_interval_ms;

    LOG_INF("ESB timing updated: base=%dms, retry=%dms", base_interval_ms, retry_interval_ms);
    return ESB_COMM_STATUS_OK;
}

/**
 * @brief Enable or disable ESB communication
 */
esb_comm_status_t esb_comm_enable(bool enable)
{
    if (!g_esb_ctx.initialized)
    {
        return ESB_COMM_STATUS_NOT_INITIALIZED;
    }

    if (enable && !g_esb_ctx.enabled)
    {
        // Re-enable ESB
        LOG_INF("Enabling ESB communication");
        g_esb_ctx.enabled = true;
    }
    else if (!enable && g_esb_ctx.enabled)
    {
        // Disable ESB
        LOG_INF("Disabling ESB communication");
        esb_disable();
        g_esb_ctx.enabled = false;
    }

    return ESB_COMM_STATUS_OK;
}

/**
 * @brief Enter low power mode (disables ESB)
 */
esb_comm_status_t esb_comm_enter_sleep(void)
{
    if (!g_esb_ctx.initialized)
    {
        return ESB_COMM_STATUS_NOT_INITIALIZED;
    }

    LOG_INF("ESB entering sleep mode");
    esb_disable();
    g_esb_ctx.enabled = false;

    // Turn off status LED
    if (g_esb_ctx.config.status_led)
    {
        gpio_pin_set_dt(g_esb_ctx.config.status_led, 0);
    }

    return ESB_COMM_STATUS_OK;
}

/**
 * @brief Wake up from low power mode (re-enables ESB)
 */
esb_comm_status_t esb_comm_wakeup(void)
{
    if (!g_esb_ctx.initialized)
    {
        return ESB_COMM_STATUS_NOT_INITIALIZED;
    }

    LOG_INF("ESB waking up from sleep mode");

    // Re-initialize ESB with current configuration
    esb_comm_status_t status = esb_comm_driver_init(&g_esb_ctx.config);
    if (status != ESB_COMM_STATUS_OK)
    {
        LOG_ERR("Failed to re-initialize ESB after wakeup: %d", status);
        return status;
    }

    return ESB_COMM_STATUS_OK;
}

/**
 * @brief Get current ESB communication status
 */
bool esb_comm_is_ready(void)
{
    return g_esb_ctx.initialized && g_esb_ctx.enabled;
}

/**
 * @brief Get last transmission timestamp
 */
uint32_t esb_comm_get_last_tx_time(void)
{
    return g_esb_ctx.last_tx_attempt;
}

/**
 * @brief Check if last transmission was successful
 */
bool esb_comm_get_last_tx_success(void)
{
    return g_esb_ctx.last_tx_succeeded;
}

/**
 * @brief Enable ACK payload based timing
 */
esb_comm_status_t esb_comm_enable_ack_timing(bool enable)
{
    if (!g_esb_ctx.initialized)
    {
        return ESB_COMM_STATUS_NOT_INITIALIZED;
    }

    g_esb_ctx.ack_timing_enabled = enable;
    LOG_INF("ACK payload timing %s", enable ? "enabled" : "disabled");
    return ESB_COMM_STATUS_OK;
}

/**
 * @brief Get current rumble data from last ACK payload
 */
esb_comm_status_t esb_comm_get_rumble_data(uint8_t *left_motor, uint8_t *right_motor)
{
    if (!left_motor || !right_motor)
    {
        return ESB_COMM_STATUS_ERROR;
    }

    *left_motor = g_esb_ctx.current_rumble_left;
    *right_motor = g_esb_ctx.current_rumble_right;

    return ESB_COMM_STATUS_OK;
}

/**
 * @brief Get dongle timestamp from last ACK payload
 */
uint32_t esb_comm_get_dongle_timestamp(void)
{
    return g_esb_ctx.last_ack_data.dongle_timestamp;
}

/**
 * @brief Get next transmission delay from last ACK payload
 */
uint16_t esb_comm_get_next_delay(void)
{
    return g_esb_ctx.next_tx_delay_ms;
}
```
