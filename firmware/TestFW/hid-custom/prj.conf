## prj.conf
```kconfig
CONFIG_USB_DEVICE_STACK_NEXT=y
CONFIG_USB_DEVICE_STACK=n
CONFIG_USBD_HID_SUPPORT=y

CONFIG_LOG=n
CONFIG_USBD_LOG_LEVEL_WRN=n
CONFIG_USBD_HID_LOG_LEVEL_WRN=n
CONFIG_UDC_DRIVER_LOG_LEVEL_WRN=n
CONFIG_SAMPLE_USBD_PID=0x10C6

CONFIG_SAMPLE_USBD_MANUFACTURER="TommyB's"
CONFIG_SAMPLE_USBD_PRODUCT="OpenSplitDeck"
CONFIG_SAMPLE_USBD_MAX_POWER=250
CONFIG_SAMPLE_USBD_20_EXTENSION_DESC=y

CONFIG_GPIO=y
CONFIG_INPUT=y

# Enhanced ShockBurst configuration
CONFIG_ESB=y

# Increase main thread stack size for dual controller processing
CONFIG_MAIN_STACK_SIZE=8192

# High priority system workqueue to prevent ESB blocking
CONFIG_SYSTEM_WORKQUEUE_PRIORITY=-1
CONFIG_MAIN_THREAD_PRIORITY=7
```

## src/controller_esb.c
```c
#include "controller_esb.h"
#include <zephyr/drivers/gpio.h>
#include <zephyr/drivers/clock_control.h>
#include <zephyr/drivers/clock_control/nrf_clock_control.h>
#include <zephyr/logging/log.h>

LOG_MODULE_REGISTER(controller_esb, LOG_LEVEL_INF);


// Define the player ID for the controller
#define PLAYER_ID 2

// ESB data structures
static struct esb_payload rx_payload;

// SEPARATE CONTROLLER STATES - prevents data corruption between controllers
static simple_controller_state_t left_controller_state = {0};   // Index 1 (flags & 0x80 = true)
static simple_controller_state_t right_controller_state = {0};  // Index 0 (flags & 0x80 = false)

// LED for debug feedback
static const struct gpio_dt_spec led0 = GPIO_DT_SPEC_GET(DT_ALIAS(led0), gpios);

// Timing tracking for packet logging
static uint32_t last_packet_time = 0;

// ACK payload timing control variables
static uint8_t sequence_counter = 0;
static uint32_t last_tx_time[2] = {0, 0};  // Separate timing for each controller: [0]=right, [1]=left
static uint32_t last_any_rx_time = 0;      // Track most recent packet from ANY controller for collision detection
static const uint16_t BASE_INTERVAL_MS = 4;  // 4ms intervals for low latency (250Hz per controller)
static bool right_phase_toggle = false;     // Toggles RIGHT controller between 2ms and 6ms to maintain 2ms offset from LEFT

// Haptics state
static uint8_t left_rumble_amplitude = 0;
static uint8_t right_rumble_amplitude = 0;

// ESB event handler for ACK-based reception
static void simple_esb_event_handler(struct esb_evt const *event)
{
    // Always log events to debug communication
    // LOG_INF("DONGLE ESB EVENT: %d", event->evt_id);

    switch (event->evt_id)
    {
    case ESB_EVENT_RX_RECEIVED:
        // LOG_INF("RX RECEIVED - got controller data");
        
        uint32_t rx_start = k_uptime_get_32();
        static uint32_t last_rx_process_time = 0;
        
        // Get the received data
        if (esb_read_rx_payload(&rx_payload) == 0)
        {
            // Filter out spurious packets - we only want controller data
            if (rx_payload.length == sizeof(controller_data_t))
            {
                // LOG_INF("Valid controller data - length: %d, pipe: %d", rx_payload.length, rx_payload.pipe);
                // Parse the controller data
                controller_data_t *data = (controller_data_t *)rx_payload.data;

                // Calculate timing and determine controller half
                uint32_t current_time = k_uptime_get_32();
                uint32_t time_diff = current_time - last_packet_time;
                bool is_left = (data->flags & 0x80) != 0;
                uint8_t controller_id = is_left ? 1 : 0;

                // Calculate gap since ANY controller packet for collision detection (BEFORE updating timing)
                uint32_t gap_since_any = (last_any_rx_time == 0) ? 0 : (current_time - last_any_rx_time);

                // Log only problematic timing patterns to reduce logging overhead
                if (last_packet_time != 0 && time_diff < 2)
                {
                    LOG_WRN("COLLISION: %s controller - %dms gap (too close!)",
                            is_left ? "LEFT" : "RIGHT", time_diff);
                    
                    // Also log per-controller timing for collisions
                    uint32_t controller_gap = (last_tx_time[controller_id] == 0) ? 0 : 
                                             (current_time - last_tx_time[controller_id]);
                    LOG_WRN("    Controller gap: %dms since last from THIS controller", controller_gap);
                }

                // Update timing variables AFTER calculating gaps
                last_packet_time = current_time;
                last_any_rx_time = current_time;

                // IMMEDIATE CONTROLLER ROUTING - store data in correct controller array immediately
                // This prevents data corruption when both controllers transmit rapidly
                simple_controller_state_t *target_controller = is_left ? &left_controller_state : &right_controller_state;
                
                target_controller->flags = data->flags;
                target_controller->trigger = data->trigger;
                target_controller->stickX = data->stickX;
                target_controller->stickY = data->stickY;
                target_controller->padX = data->padX;
                target_controller->padY = data->padY;
                target_controller->buttons = data->buttons;
                target_controller->accelX = data->accelX;
                target_controller->accelY = data->accelY;
                target_controller->accelZ = data->accelZ;
                target_controller->gyroX = data->gyroX;
                target_controller->gyroY = data->gyroY;
                target_controller->gyroZ = data->gyroZ;
                target_controller->data_received = true;
                target_controller->last_ping_time = current_time;

                // Track severe delays that indicate controller-side issues
                if (time_diff > 50) {
                    LOG_ERR("SEVERE DELAY: %dms gap from %s controller - likely controller freeze", 
                            time_diff, is_left ? "LEFT" : "RIGHT");
                }

                // Create ACK payload with timing control + rumble (8-byte design)
                ack_timing_data_t ack_data = {
                    .next_delay_ms = 0,        // Will calculate below
                    .sequence_num = sequence_counter++,
                    .left_rumble = left_rumble_amplitude,   // S-Input haptics (0-255)
                    .right_rumble = right_rumble_amplitude, // S-Input haptics (0-255)
                    .reserved = 0,
                    .dongle_timestamp = (uint16_t)(current_time & 0xFFFF) // Truncated timestamp
                };
                
                // Simple fixed staggering: LEFT=4ms, RIGHT=3ms
                // This creates natural offset without complex logic
                // LEFT: 4ms intervals (0, 4, 8, 12, 16, 20, 24ms...) = 250 Hz
                // RIGHT: 3ms intervals (0, 3, 6, 9, 12, 15, 18ms...) = 333 Hz
                // Pattern: Both sync every 12ms, offset in between
                
                uint32_t delay_ms = is_left ? 4 : 3;
                
                // Set the delay
                ack_data.next_delay_ms = delay_ms;
                
                // Log fixed stagger pattern once
                static bool logged_stagger = false;
                if (!logged_stagger) {
                    LOG_INF("FIXED STAGGER: LEFT=4ms (250Hz), RIGHT=3ms (333Hz)");
                    logged_stagger = true;
                }
                
                // Update last transmission time tracking (per-controller)
                last_tx_time[controller_id] = current_time;
                
                // NOTE: last_any_rx_time already updated above after gap calculation
                
                // Queue ACK payload using Nordic's approach - this goes into TX FIFO
                // and will be attached to the ACK for the NEXT packet received on this pipe
                struct esb_payload ack_tx_payload = {0};
                ack_tx_payload.pipe = rx_payload.pipe;        // CRUCIAL - same pipe as RX
                ack_tx_payload.length = sizeof(ack_timing_data_t); // 8 bytes
                memcpy(ack_tx_payload.data, &ack_data, ack_tx_payload.length);
                
                // Queue it - this attaches to the next ACK on this pipe
                int result = esb_write_payload(&ack_tx_payload);
                if (result != 0) {
                    LOG_WRN("Failed to queue ACK payload: %d", result);
                }

                gpio_pin_set_dt(&led0, 1);
            }
            else
            {
                // LOG_DBG("Ignoring packet with wrong length: %d (expected %d)",
                //         rx_payload.length, sizeof(controller_data_t));
            }
        }
        else
        {
            LOG_WRN("Failed to read RX payload");
        }
        
        // Monitor RX processing time
        uint32_t rx_process_time = k_uptime_get_32() - rx_start;
        if (rx_process_time > 2) { // Warn if RX processing takes over 2ms
            LOG_WRN("Slow RX processing: %dms", rx_process_time);
        }
        
        // Track time between RX processing - only warn on major delays
        if (last_rx_process_time != 0) {
            uint32_t rx_interval = rx_start - last_rx_process_time;
            if (rx_interval > 20) { // Only warn if > 20ms (was 8ms)
                LOG_WRN("Long RX interval: %dms", rx_interval);
            }
        }
        last_rx_process_time = rx_start;
        
        break;

    case ESB_EVENT_TX_SUCCESS:
        // ACK payloads transmitted successfully
        break;

    case ESB_EVENT_TX_FAILED:
        LOG_WRN("Failed to send ACK payload - flushing TX queue");
        // For PRX, this usually means the queued ACK payload couldn't be sent
        // Flush the TX FIFO to clear any stuck payloads
        esb_flush_tx();
        break;

    default:
        LOG_WRN("Unknown ESB event: %d", event->evt_id);
        break;
    }
}

// Clock initialization (based on Nordic reference)
int clocks_start(void)
{
    int err;
    int res;
    struct onoff_manager *clk_mgr;
    struct onoff_client clk_cli;

    clk_mgr = z_nrf_clock_control_get_onoff(CLOCK_CONTROL_NRF_SUBSYS_HF);
    if (!clk_mgr)
    {
        LOG_ERR("Unable to get the Clock manager");
        return -ENXIO;
    }

    sys_notify_init_spinwait(&clk_cli.notify);

    err = onoff_request(clk_mgr, &clk_cli);
    if (err < 0)
    {
        LOG_ERR("Clock request failed: %d", err);
        return err;
    }

    do
    {
        err = sys_notify_fetch_result(&clk_cli.notify, &res);
        if (!err && res)
        {
            LOG_ERR("Clock could not be started: %d", res);
            return res;
        }
    } while (err);

    return 0;
}

// Initialize ESB for ACK-based controller communication
int controller_esb_init(void)
{
    int err;

    // Start clocks first (like Nordic reference)
    err = clocks_start();
    if (err)
    {
        LOG_ERR("Clock start failed: %d", err);
        return err;
    }

    // Initialize LED
    if (!gpio_is_ready_dt(&led0))
    {
        return -ENODEV;
    }
    gpio_pin_configure_dt(&led0, GPIO_OUTPUT_INACTIVE);

    // ESB configuration - PRX mode to receive controller data and send ACKs
    // Based on Nordic reference sample
    struct esb_config config = ESB_DEFAULT_CONFIG;
    config.protocol = ESB_PROTOCOL_ESB_DPL;
    config.mode = ESB_MODE_PRX; // Receiver mode to listen and send ACKs
    config.retransmit_delay = 1000;
    config.retransmit_count = 5;
    config.event_handler = simple_esb_event_handler;
    config.bitrate = ESB_BITRATE_2MBPS;
    config.selective_auto_ack = true; // Enable ACK for timing coordination
    config.use_fast_ramp_up = false;

    // Initialize ESB
    err = esb_init(&config);
    if (err)
    {
        LOG_ERR("ESB init failed: %d", err);
        return err;
    }

    // Set addresses - using same pattern as Nordic reference but matching controller
    uint8_t base_addr_0[4];
    uint8_t base_addr_1[4];
    uint8_t addr_prefix[8];
    


#if PLAYER_ID == 1
    // Player 1 addresses
    base_addr_0[0] = 0xE7; base_addr_0[1] = 0xE7; base_addr_0[2] = 0xE7; base_addr_0[3] = 0xE7;
    base_addr_1[0] = 0xD4; base_addr_1[1] = 0xD4; base_addr_1[2] = 0xD4; base_addr_1[3] = 0xD4;
    addr_prefix[0] = 0xE7; addr_prefix[1] = 0xD4; addr_prefix[2] = 0xC3; addr_prefix[3] = 0xC4;
    addr_prefix[4] = 0xC5; addr_prefix[5] = 0xC6; addr_prefix[6] = 0xC7; addr_prefix[7] = 0xC8;
#elif PLAYER_ID == 2
    // Player 2 addresses
    base_addr_0[0] = 0xA1; base_addr_0[1] = 0xA1; base_addr_0[2] = 0xA1; base_addr_0[3] = 0xA1;
    base_addr_1[0] = 0xB2; base_addr_1[1] = 0xB2; base_addr_1[2] = 0xB2; base_addr_1[3] = 0xB2;
    addr_prefix[0] = 0xA1; addr_prefix[1] = 0xB2; addr_prefix[2] = 0xA3; addr_prefix[3] = 0xA4;
    addr_prefix[4] = 0xA5; addr_prefix[5] = 0xA6; addr_prefix[6] = 0xA7; addr_prefix[7] = 0xA8;
#else
    #error "PLAYER_ID must be 1 or 2"
#endif

    err = esb_set_base_address_0(base_addr_0);
    if (err)
    {
        LOG_ERR("ESB set base address 0 failed: %d", err);
        return err;
    }

    err = esb_set_base_address_1(base_addr_1);
    if (err)
    {
        LOG_ERR("ESB set base address 1 failed: %d", err);
        return err;
    }

    err = esb_set_prefixes(addr_prefix, 8);
    if (err)
    {
        LOG_ERR("ESB set prefixes failed: %d", err);
        return err;
    }

    // Set RF channel - using 2450 MHz (channel 50) to avoid WiFi interference
    // This sits between WiFi channels 8 and 9, reducing interference
    err = esb_set_rf_channel(50);
    if (err)
    {
        LOG_ERR("ESB set RF channel failed: %d", err);
        return err;
    }

    // Set radio TX power to maximum
    err = esb_set_tx_power(ESB_TX_POWER_8DBM);
    if (err)
    {
        LOG_ERR("ESB set TX power failed: %d", err);
        return err;
    }

    // Write initial payload (like Nordic PRX reference does)
    struct esb_payload tx_payload = {0};
    tx_payload.length = 8;
    tx_payload.pipe = 0;
    tx_payload.data[0] = 0x10;
    tx_payload.data[1] = 0x11;

    err = esb_write_payload(&tx_payload);
    if (err)
    {
        LOG_ERR("Initial payload write failed: %d", err);
        return err;
    }

    // Start receiving (like Nordic reference)
    err = esb_start_rx();
    if (err)
    {
        LOG_ERR("ESB start RX failed: %d", err);
        return err;
    }

    return 0;
}

// Get current controller state
// Legacy function - returns right controller for backward compatibility
simple_controller_state_t *controller_esb_get_state(void)
{
    return &right_controller_state;
}

// Get left controller state
simple_controller_state_t *controller_esb_get_left_state(void)
{
    return &left_controller_state;
}

// Get right controller state
simple_controller_state_t *controller_esb_get_right_state(void)
{
    return &right_controller_state;
}

// Check if we have new data from either controller
bool controller_esb_has_new_data(void)
{
    // Consider data "new" if we received it within the last 100ms from either controller
    uint32_t now = k_uptime_get_32();
    bool left_has_data = left_controller_state.data_received &&
                        (now - left_controller_state.last_ping_time) < 100;
    bool right_has_data = right_controller_state.data_received &&
                         (now - right_controller_state.last_ping_time) < 100;
    return left_has_data || right_has_data;
}

// Set haptics/rumble values (called from USB HID haptics callback)
void controller_esb_set_haptics(uint8_t left_amplitude, uint8_t right_amplitude)
{
    left_rumble_amplitude = left_amplitude;
    right_rumble_amplitude = right_amplitude;
    
    // Log haptics changes for debugging
    static uint8_t last_left = 0, last_right = 0;
    if (left_amplitude != last_left || right_amplitude != last_right)
    {
        LOG_INF("Haptics set: L=%u, R=%u", left_amplitude, right_amplitude);
        last_left = left_amplitude;
        last_right = right_amplitude;
    }
}
```

## src/usb_hid_sinput.c
```c
#include "usb_hid_sinput.h"
#include <sample_usbd.h>
#include <zephyr/usb/usb_device.h>
#include <zephyr/usb/usbd.h>
#include <zephyr/usb/class/usbd_hid.h>
#include <zephyr/device.h>
#include <zephyr/sys/util.h>
#include <zephyr/logging/log.h>
#include <string.h>

LOG_MODULE_REGISTER(usb_hid_sinput, LOG_LEVEL_INF);

static K_SEM_DEFINE(ep_write_sem, 0, 1);
static const struct device *hid_device = NULL;

// IMU timestamp counter
static uint32_t imu_timestamp_us = 0;

// Haptics callback storage
static void (*haptics_callback)(uint8_t left_amp, uint8_t right_amp) = NULL;

// Feature query response flag
static bool feature_query_pending = false;

// Feature response packet (Report ID 0x02, 63 bytes)
static uint8_t feature_response[63] = {
    0x02,       // Command ID
    0x00, 0x00, // Protocol Version
    0xFF,       // Feature Flags 1
    0xFF,       // Feature Flags 2
    0x05,       // Gamepad Physical Type (PS4 style)
    0x1F,       // Face Style / Sub-product
    0b10100000, 0b00001111, // Polling rate (paste right side, then left side)
    0x00, 0x10, // Accelerometer range
    0b11110100, 0b00000001, // Gyroscope range
    0xFF, 0xFF, 0xFF, 0x00, // Button Usage Mask (24 buttons: face, dpad, shoulders, triggers, sticks, paddles, touchpads, guide, start/select, capture)
    0x01,       // Touchpad count (1 touchpad - split in half by application)
    0x02,       // Touchpad finger count (2 fingers)
    0x00, 0x00, 0x00, 0x69, 0x04, 0x20, // MAC address
    // Remaining 37 bytes reserved/padding
    0x00, 0x00, 0x00, 0x00, 0x00, 0x00, 0x00, 0x00, 0x00, 0x00,
    0x00, 0x00, 0x00, 0x00, 0x00, 0x00, 0x00, 0x00, 0x00, 0x00,
    0x00, 0x00, 0x00, 0x00, 0x00, 0x00, 0x00, 0x00, 0x00, 0x00,
    0x00, 0x00, 0x00, 0x00, 0x00, 0x00, 0x00
};

// S-Input HID Report Descriptor with proper touchpad support
static const uint8_t sinput_hid_report_descriptor[] = {
    0x05, 0x01,                    // Usage Page (Generic Desktop Ctrls)
    0x09, 0x05,                    // Usage (Gamepad)
    0xA1, 0x01,                    // Collection (Application)
    
    // INPUT REPORT ID 0x01 - Main gamepad data
    0x85, 0x01,                    //   Report ID (1)
    
    // Padding bytes (bytes 1-2) - Plug status and Charge Percent
    0x06, 0x00, 0xFF,              //   Usage Page (Vendor Defined)
    0x09, 0x01,                    //   Usage (Vendor Usage 1)
    0x15, 0x00,                    //   Logical Minimum (0)
    0x25, 0xFF,                    //   Logical Maximum (255)
    0x75, 0x08,                    //   Report Size (8)
    0x95, 0x02,                    //   Report Count (2)
    0x81, 0x02,                    //   Input (Data,Var,Abs)

    // --- 24 buttons (reduced from 32 to match actual usage) ---
    0x05, 0x09,                    // Usage Page (Button)
    0x19, 0x01,                    //   Usage Minimum (Button 1)
    0x29, 0x18,                    //   Usage Maximum (Button 24)
    0x15, 0x00,                    //   Logical Min (0)
    0x25, 0x01,                    //   Logical Max (1)
    0x75, 0x01,                    //   Report Size (1)
    0x95, 0x18,                    //   Report Count (24)
    0x81, 0x02,                    //   Input (Data,Var,Abs)
    
    // Analog Sticks and Triggers
    0x05, 0x01,                    // Usage Page (Generic Desktop)
    // Left Stick X, Y (centered)
    0x09, 0x30,                    //   Usage (X)
    0x09, 0x31,                    //   Usage (Y)
    0x16, 0x00, 0x80,              //   Logical Minimum (-32768)
    0x26, 0xFF, 0x7F,              //   Logical Maximum (32767)
    0x75, 0x10,                    //   Report Size (16)
    0x95, 0x02,                    //   Report Count (2)
    0x81, 0x02,                    //   Input (Data,Var,Abs)
    
    // Right Stick X, Y (centered)
    0x09, 0x32,                    //   Usage (Z)
    0x09, 0x35,                    //   Usage (Rz)
    0x16, 0x00, 0x80,              //   Logical Minimum (-32768)
    0x26, 0xFF, 0x7F,              //   Logical Maximum (32767)
    0x75, 0x10,                    //   Report Size (16)
    0x95, 0x02,                    //   Report Count (2)
    0x81, 0x02,                    //   Input (Data,Var,Abs)
    
    // Triggers (centered at 0: -32768 to 32767)
    0x09, 0x34,                    //   Usage (Ry) - Left trigger
    0x09, 0x33,                    //   Usage (Rx) - Right trigger
    0x16, 0x00, 0x80,              //   Logical Minimum (-32768)
    0x26, 0xFF, 0x7F,              //   Logical Maximum (32767)
    0x75, 0x10,                    //   Report Size (16)
    0x95, 0x02,                    //   Report Count (2)
    0x81, 0x02,                    //   Input (Data,Var,Abs)
    
    // IMU Timestamp (vendor-defined, 4 bytes)
    0x06, 0x00, 0xFF,              // Usage Page (Vendor Defined)
    0x09, 0x20,                    //   Usage (Vendor Usage 0x20)
    0x15, 0x00,                    //   Logical Minimum (0)
    0x27, 0xFF, 0xFF, 0xFF, 0xFF,  //   Logical Maximum (4294967295)
    0x75, 0x20,                    //   Report Size (32)
    0x95, 0x01,                    //   Report Count (1)
    0x81, 0x02,                    //   Input (Data,Var,Abs)

    // Motion data and Reserved data - 44 bytes
    // This includes gyro/accel data and touchpad that apps can use if supported
    0x06, 0x00, 0xFF,              // Usage Page (Vendor Defined)
    
    // Motion Input Accelerometer XYZ (Gs) and Gyroscope XYZ (Degrees Per Second)
    0x09, 0x21,                    //   Usage (Vendor Usage 0x21)
    0x16, 0x00, 0x80,              //   Logical Minimum (-32768)
    0x26, 0xFF, 0x7F,              //   Logical Maximum (32767)
    0x75, 0x10,                    //   Report Size (16)
    0x95, 0x06,                    //   Report Count (6)
    0x81, 0x02,                    //   Input (Data,Var,Abs)

    // Reserved padding (29 bytes includes touchpad data)
    0x09, 0x22,                    //   Usage (Vendor Usage 0x22)
    0x15, 0x00,                    //   Logical Minimum (0)
    0x26, 0xFF, 0x00,              //   Logical Maximum (255)
    0x75, 0x08,                    //   Report Size (8)
    0x95, 0x1D,                    //   Report Count (29)
    0x81, 0x02,                    //   Input (Data,Var,Abs)
    
    // INPUT REPORT ID 0x02 - Vendor COMMAND data
    0x85, 0x02,                    //   Report ID (2)
    0x09, 0x23,                    //   Usage (Vendor Usage 0x23)
    0x15, 0x00,                    //   Logical Minimum (0)
    0x26, 0xFF, 0x00,              //   Logical Maximum (255)
    0x75, 0x08,                    //   Report Size (8 bits)
    0x95, 0x3F,                    //   Report Count (63)
    0x81, 0x02,                    //   Input (Data,Var,Abs)

    // OUTPUT REPORT ID 0x03 - Vendor COMMAND data (haptics)
    0x85, 0x03,                    //   Report ID (3)
    0x09, 0x24,                    //   Usage (Vendor Usage 0x24)
    0x15, 0x00,                    //   Logical Minimum (0)
    0x26, 0xFF, 0x00,              //   Logical Maximum (255)
    0x75, 0x08,                    //   Report Size (8 bits)
    0x95, 0x2F,                    //   Report Count (47)
    0x91, 0x02,                    //   Output (Data,Var,Abs)

    0xC0                           // End Collection 
};

static int enable_usb_device_next(void)
{
    struct usbd_context *sample_usbd;
    int err;

    sample_usbd = sample_usbd_init_device(NULL);
    if (sample_usbd == NULL)
    {
        LOG_ERR("Failed to initialize USB device");
        return -ENODEV;
    }

    // Set VID/PID for S-Input
    // Using Raspberry Pi Foundation VID with S-Input generic PID
    usbd_device_set_vid(sample_usbd, 0x2E8A); // Raspberry Pi Foundation
    usbd_device_set_pid(sample_usbd, 0x10C6); // S-Input Generic Device

    err = usbd_enable(sample_usbd);
    if (err)
    {
        LOG_ERR("Failed to enable device support");
        return err;
    }

    LOG_INF("USB device support enabled (S-Input protocol)");
    return 0;
}

static void int_in_ready_cb(const struct device *dev)
{
    ARG_UNUSED(dev);
    k_sem_give(&ep_write_sem);
}

// Feature/Output report callback for HID Get Report requests
static int get_report_cb(const struct device *dev, uint8_t type, uint8_t id, uint16_t len, uint8_t *buf)
{
    ARG_UNUSED(dev);
    
    LOG_DBG("GET REPORT: type=%u, id=0x%02x, len=%u", type, id, len);
    
    // S-Input doesn't require complex feature reports like DS4
    // Most configuration is done via the HID descriptor itself
    
    return -ENOTSUP;
}

// Output report callback for HID Set Report requests (haptics, LEDs, feature query)
static int set_report_cb(const struct device *dev, const uint8_t type, const uint8_t id,
                         const uint16_t len, const uint8_t *const buf)
{
    ARG_UNUSED(dev);

    LOG_INF("SET REPORT: type=%u, id=0x%02x, len=%u", type, id, len);
    
    // Log first few bytes for debugging
    if (buf && len > 0) {
        LOG_INF("  Data: %02x %02x %02x %02x", 
                buf[0], 
                len > 1 ? buf[1] : 0,
                len > 2 ? buf[2] : 0,
                len > 3 ? buf[3] : 0);
    }

    // Handle output reports (type 2) - can be Report ID 0x00 or 0x03
    if (type == 2)
    {
        if (buf && len >= 1)
        {
            // Some hosts include report ID in buf[0], others don't.
            // Normalize so payload[0] is always command_id.
            const uint8_t *payload = buf;
            uint16_t payload_len = len;
            if (id != 0 && buf[0] == id && len > 1) {
                payload = &buf[1];
                payload_len = len - 1;
            }
 
            if (payload_len < 1) {
                return 0;
            }

            // payload[0] = command ID (0x01, 0x02, 0x03, 0x04, etc.)
            uint8_t command_id = payload[0];
            
            LOG_INF("S-Input command received: 0x%02x (report_id=0x%02x)", command_id, id);
            
            switch (command_id)
            {
                case 0x02: // Feature Query - Steam/SDL uses this to discover touchpad
                {
                    LOG_INF("Feature query received - will send feature response");
                    feature_query_pending = true;
                    return 0; // Acknowledge immediately
                }                
                case 0x01: // Haptics command
                {
                    if (payload_len >= 2)
                    {
                        uint8_t haptic_type = payload[1];
                        LOG_INF("RUMBLE CMD: len=%u type=0x%02x b0=%02x b1=%02x b2=%02x b3=%02x b4=%02x b5=%02x",
                                len,
                                haptic_type,
                                buf[0],
                                len > 1 ? buf[1] : 0,
                                len > 2 ? buf[2] : 0,
                                len > 3 ? buf[3] : 0,
                                len > 4 ? buf[4] : 0,
                                len > 5 ? buf[5] : 0);
                        
                        if (haptic_type == 0x02 && payload_len >= 6)
                        {
                            // Type 2 - ERM Stereo Haptics (simple)
                            uint8_t left_amplitude = payload[2];
                            // bool left_brake = payload[3]; // Could be used for more advanced control
                            uint8_t right_amplitude = payload[4];
                            // bool right_brake = payload[5];
                            
                            LOG_DBG("Haptics Type 2: L=%u, R=%u", left_amplitude, right_amplitude);
                            LOG_INF("RUMBLE TYPE2: L=%u R=%u", left_amplitude, right_amplitude);
                            
                            // Call haptics callback if registered
                            if (haptics_callback)
                            {
                                haptics_callback(left_amplitude, right_amplitude);
                            }
                        }
                        else if (haptic_type == 0x01 && payload_len >= 18)
                        {
                            // Type 1 - Precise Stereo Haptics (frequency/amplitude pairs)
                            // This is more complex - could convert to simple amplitude
                            uint16_t left_amp1 = ((uint16_t)payload[4] << 8) | payload[3];
                            uint16_t right_amp1 = ((uint16_t)payload[12] << 8) | payload[11];
                            
                            // Convert 16-bit to 8-bit amplitude
                            uint8_t left_amp = (uint8_t)(left_amp1 >> 8);
                            uint8_t right_amp = (uint8_t)(right_amp1 >> 8);
                            
                            LOG_DBG("Haptics Type 1: L=%u, R=%u", left_amp, right_amp);
                            LOG_INF("RUMBLE TYPE1: L=%u R=%u", left_amp, right_amp);
                            
                            if (haptics_callback)
                            {
                                haptics_callback(left_amp, right_amp);
                            }
                        }
                        else
                        {
                            LOG_WRN("RUMBLE CMD: unhandled format type=0x%02x len=%u", haptic_type, len);
                        }
                    }
                    break;
                }
                
                case 0x03: // Player LEDs
                {
                    if (payload_len >= 2)
                    {
                        uint8_t player_num = payload[1];
                        LOG_DBG("Player LED: %u", player_num);
                        // TODO: Could implement player LED control
                    }
                    break;
                }
                
                case 0x04: // Joystick RGB
                {
                    if (payload_len >= 4)
                    {
                        uint8_t red = payload[1];
                        uint8_t green = payload[2];
                        uint8_t blue = payload[3];
                        LOG_DBG("Joystick RGB: R=%u, G=%u, B=%u", red, green, blue);
                        // TODO: Could implement RGB LED control
                    }
                    break;
                }
                
                default:
                    LOG_DBG("Unknown S-Input command: 0x%02x", command_id);
                    break;
            }
        }
        
        // Acknowledge the output request
        return 0;
    }

    return -ENOTSUP;
}

static const struct hid_device_ops ops = {
    .input_report_done = int_in_ready_cb,
    .get_report = get_report_cb,
    .set_report = set_report_cb,
};

// Initialize S-Input USB HID device
int usb_hid_sinput_init(void)
{
    int ret;

    hid_device = DEVICE_DT_GET_ONE(zephyr_hid_device);

    if (hid_device == NULL)
    {
        LOG_ERR("Cannot get USB HID Device");
        return -ENODEV;
    }

    hid_device_register(hid_device,
                        sinput_hid_report_descriptor, 
                        sizeof(sinput_hid_report_descriptor),
                        &ops);

    ret = enable_usb_device_next();

    if (ret != 0)
    {
        LOG_ERR("Failed to enable USB");
        return ret;
    }

    LOG_INF("S-Input USB HID device initialized");
    return 0;
}

// Get the HID device handle
const struct device *usb_hid_sinput_get_device(void)
{
    return hid_device;
}

// Send S-Input gamepad report
int usb_hid_sinput_send_report(const struct device *hid_dev, const sinput_input_report_t *report)
{
    if (!hid_dev || !report)
    {
        return -EINVAL;
    }

    // Check if feature query is pending - send feature response first
    if (feature_query_pending)
    {
        LOG_INF("Sending feature response (Report ID 0x02)");
        feature_query_pending = false;
        
        // Send feature response as Report ID 0x02
        uint8_t feature_report[64] = {SINPUT_COMMAND_REPORT_ID}; // Report ID 0x02
        memcpy(&feature_report[1], feature_response, 63);
        
        int ret = hid_int_ep_write(hid_dev, feature_report, 64, NULL);
        if (ret == 0)
        {
            k_sem_take(&ep_write_sem, K_FOREVER);
        }
        else
        {
            LOG_ERR("Feature response write failed: %d", ret);
        }
    }

    // Update IMU timestamp (increment by ~4ms worth of microseconds for 250Hz polling)
    imu_timestamp_us += 4000;
    
    // Create mutable copy to set timestamp
    sinput_input_report_t report_copy = *report;
    report_copy.imu_timestamp_us = imu_timestamp_us;

    int ret = hid_int_ep_write(hid_dev, (uint8_t *)&report_copy, sizeof(sinput_input_report_t), NULL);
    if (ret == 0)
    {
        k_sem_take(&ep_write_sem, K_FOREVER);
    }
    else
    {
        LOG_ERR("HID write failed: %d", ret);
    }

    return ret;
}

// Register haptics callback (called when host sends haptics commands)
void usb_hid_sinput_register_haptics_callback(void (*callback)(uint8_t left_amp, uint8_t right_amp))
{
    haptics_callback = callback;
}
```
